## drivers/input/touchscreen/ilitek/common/Kconfig
```kconfig
#
# Ilitek ili9881x touchscreen driver configuration
#

config TOUCHSCREEN_ILITEK_COMMON_SPI
	tristate "Ilitek common SPI driver"
	default y
	help
	  Say Y here if you have a Ilitek no flash touchscreen connected
	  to your system by SPI bus.

	  If unsure, say N.
```

## techpack/display/msm/samsung/M44X_ILI7807S_BS066FBM/Kconfig
```kconfig
config  PANEL_M44X_ILI7807S_BS066FBM_FHD
	depends on DISPLAY_SAMSUNG
	bool "BOE ILI7807S TDDI"
	default n
	---help---
	BOE ILI7807S TDDI 1080_2408 M44X

config  PANEL_BUILTIN_BACKLIGHT
	depends on DISPLAY_SAMSUNG
	bool "external backlight IC"
	default n
	---help---
	external backlight IC 1080_2408 M44X
	
```
